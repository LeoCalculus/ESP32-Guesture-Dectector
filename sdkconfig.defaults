## sdkconfig.defaults
```kconfig
# Bluetooth Configuration
CONFIG_BT_ENABLED=y
CONFIG_BT_BLUEDROID_ENABLED=y
CONFIG_BT_CLASSIC_ENABLED=y
CONFIG_BT_BLE_ENABLED=y
CONFIG_BT_CONTROLLER_ENABLED=y
CONFIG_BT_NIMBLE_ENABLED=n

# Component Configuration
CONFIG_ESP_SYSTEM_EVENT_QUEUE_SIZE=32
CONFIG_ESP_SYSTEM_EVENT_TASK_STACK_SIZE=2048

# WiFi (if needed)
CONFIG_ESP32_WIFI_SW_COEXIST_ENABLE=y

# FreeRTOS
CONFIG_FREERTOS_UNICORE=n
CONFIG_FREERTOS_HZ=1000

# ESP32-specific
CONFIG_ESP32_DEFAULT_CPU_FREQ_240=y
CONFIG_ESP32_DEFAULT_CPU_FREQ_MHZ=240

# Bootloader
CONFIG_BOOTLOADER_LOG_LEVEL_INFO=y

# Compiler options
CONFIG_COMPILER_OPTIMIZATION_SIZE=y
CONFIG_COMPILER_CXX_EXCEPTIONS=y
CONFIG_COMPILER_CXX_RTTI=y
```
